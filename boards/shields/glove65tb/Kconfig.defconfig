## boards/shields/glove65tb/Kconfig.defconfig
```kconfig
if SHIELD_GLOVE65TB_R

config ZMK_KEYBOARD_NAME
    default "glove65tb_R"

config ZMK_SPLIT
    default y

config ZMK_SPLIT_ROLE_CENTRAL
    default y

endif

if SHIELD_GLOVE65TB_L

config ZMK_KEYBOARD_NAME
    default "glove65tb_L"

config ZMK_SPLIT
    default y

endif
```
